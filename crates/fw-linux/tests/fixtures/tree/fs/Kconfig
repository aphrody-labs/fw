## crates/fw-linux/tests/fixtures/tree/fs/Kconfig
```kconfig
# SPDX-License-Identifier: GPL-2.0-only
menu "File systems"

config BLOCK
	bool "Enable the block layer"
	default y

config LIBFS
	tristate

config FS_RW
	tristate "Read and write support"
	depends on BLOCK && !UML
	select LIBFS
	imply FS_ACL if BLOCK
	default y if SMP
	default n
	help
	  Plain read and write.

if BLOCK

source "fs/btrfs/Kconfig"

endif # BLOCK

endmenu
```

## crates/fw-linux/tests/fixtures/tree/fs/btrfs/Kconfig
```kconfig
# SPDX-License-Identifier: GPL-2.0

config BTRFS_FS
	tristate "Btrfs filesystem support"
	select LIBFS
	select CRC32
	depends on FS_RW

config BTRFS_FS_POSIX_ACL
	bool "Btrfs POSIX Access Control Lists"
	depends on BTRFS_FS
```
